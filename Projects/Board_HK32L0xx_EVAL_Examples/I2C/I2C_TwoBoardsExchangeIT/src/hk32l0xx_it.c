/*******************************************************************************
* @copyright: Shenzhen Hangshun Chip Technology R&D Co., Ltd
* @filename:  hk32l0xx_it.c
* @brief:     Interrupt Service Routines
* @author:    AE Team
* @version:   V1.0.0/2024-01-04
*             1.Initial version
* @log:
*******************************************************************************/


/* Includes ------------------------------------------------------------------*/
#include "hk32l0xx_it.h"
#include "main.h"

/* Private typedef -----------------------------------------------------------*/
/* Private define ------------------------------------------------------------*/
/* Private macro -------------------------------------------------------------*/
/* Private variables ---------------------------------------------------------*/
extern uint8_t WriteBuf[10];
extern uint8_t ReadBuf[10];
extern uint8_t RecvFlag;
extern uint8_t SendFlag;
/* Private function prototypes -----------------------------------------------*/
/* Private functions ---------------------------------------------------------*/

/******************************************************************************/
/*            Cortex-M0 Processor Exceptions Handlers                         */
/******************************************************************************/

/**
  * @brief  This function handles NMI exception.
  * @retval None
  */
void NMI_Handler(void)
{
}

/**
  * @brief  This function handles Hard Fault exception.
  * @retval None
  */
void HardFault_Handler(void)
{
    /* Go to infinite loop when Hard Fault exception occurs */
    while (1)
    {
    }
}

/**
  * @brief  This function handles SVCall exception.
  * @retval None
  */
void SVC_Handler(void)
{
}

/**
  * @brief  This function handles PendSVC exception.
  * @retval None
  */
void PendSV_Handler(void)
{
}

/**
  * @brief  This function handles SysTick Handler.
  * @retval None
  */
void SysTick_Handler(void)
{
}

/******************************************************************************/
/*                 HK32L0xx Peripherals Interrupt Handlers                   */
/*  Add here the Interrupt Handler for the used peripheral(s) (PPP), for the  */
/*  available peripheral interrupt handler's name please refer to the startup */
/*  file (KEIL_Startup_hk32l0xx.s).                                               */
/******************************************************************************/
/**
  * @brief  This function handles I2Cx interrupt request.
  * @retval None
  */
void I2C_COMx_IRQHandler(void)
{
    static uint16_t recv_num = 0;
    static uint16_t send_num = 0;

#ifndef I2C_MASTER  /* slave open Address matching interrupt and Identify direction*/
    static uint16_t direction = 0;

    /* Address matching interrupt */
    if (I2C_GetITStatus(I2C_COMx, I2C_IT_ADDR))
    {
        I2C_ClearITPendingBit(I2C_COMx, I2C_IT_ADDR);
        direction = I2C_GetTransferDirection(I2C_COMx);

    }

#endif

    /* RX interrupt handle */
    if (I2C_GetITStatus(I2C_COMx, I2C_IT_RXNE))
    {
        ReadBuf[recv_num] = I2C_ReceiveData(I2C_COMx);
        recv_num++;

        if (recv_num == SEND_LEN) /*Received Quantity*/
        {
#ifdef I2C_MASTER /*Generate stop signal in host mode after recv data finsh*/

            /* It seems that the stop signal generated by oneself
               will not enter the stop interrupt */
            I2C_GenerateSTOP(I2C_COMx, ENABLE);
#endif

        }
    }

    /* STOP interrupt handle */
    if (I2C_GetITStatus(I2C_COMx, I2C_IT_STOPF))
    {
        /* recv or send data complate */
        if (recv_num == SEND_LEN)
        {
            RecvFlag = 1;
            recv_num = 0;
        }

        if (send_num == SEND_LEN)
        {
            SendFlag = 1;
            send_num = 0;
        }

        I2C_ClearITPendingBit(I2C_COMx, I2C_IT_STOPF);
    }

    if (I2C_GetITStatus(I2C_COMx, I2C_IT_TXIS))
    {
#ifdef I2C_MASTER /*Generate stop signal in host mode after send data finsh*/

        if (send_num != SEND_LEN) /*Number of sent items*/
        {
            /* Placing data in TXDR */
            I2C_SendData(I2C_COMx, WriteBuf[send_num++]);
        }

#else

        /* The direction is read from the master to the slave */
        if (send_num != SEND_LEN  && direction == I2C_Direction_Receiver)
        {
            /* Placing data in TXDR */
            I2C_SendData(I2C_COMx, ReadBuf[send_num++]);
        }

#endif
    }
}
/**
  * @brief  This function handles PPP interrupt request.
  * @retval None
  */
/*void PPP_IRQHandler(void)
{
}*/


